## config/west.yml
```yaml
manifest:
  remotes:
    - name: maxwu0113
      url-base: https://github.com/maxwu0113
  projects:
    - name: zmk
      remote: maxwu0113
      revision: main
      import: app/west.yml
  self:
    path: config
```
